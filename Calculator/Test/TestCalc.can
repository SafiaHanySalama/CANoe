/*@!Encoding:65001*/
includes
{
  
  
}

variables
{
  
}

TestCase testaddition()
{
  testStepBegin("step1","set Operand values by 5 and expect result 10");
  @Calculator::Op1 = 5;
  @Calculator::Op2 = 5;
  @Calculator::Operator = @Calculator::Display::Button_Addition;
  testWaitForSysVar(sysvar::Calculator::Result,20);
  if (@Calculator::Result == 10)
  {
    testStepPass("step1 result","value is 10");
  } 
  else{
    testStepFail("step1 result","value not equal 10");
  }
}

void MainTest()
{
  testaddition();
}